## drivers/input/touchscreen/mediatek/Kconfig
```kconfig
#
# Touchscreen driver configuration
#
menuconfig INPUT_TOUCHSCREEN
	bool "Touchscreens"
	help
	  Say Y here, and a list of supported touchscreens will be displayed.
	  This option doesn't affect the kernel.

	  If unsure, say Y.

if INPUT_TOUCHSCREEN

config TOUCHSCREEN_MTK
	bool "MediaTek Touch Panel Driver"
	help
	  Say Y here if you have MediaTek touch panel.

	  If unsure, say N.

	  To compile this dirver as a module, choose M here: the
	  module will be called.

config TOUCHSCREEN_PHYSICAL_ROTATION_WITH_LCM
	bool "MediaTek Touch Panel Rotation With LCM"
	default y
	help
	  Say N here if touch panel is not physical rotated as LCM does.
	  Physically rotated means that this driver will map
	  the reported coordination to diagonal position.

	  If unsure, say Y.

config TOUCHSCREEN_HIMAX_CHIPSET
	bool "HIMAX for Mediatek package"
	default n
	help
	  Say Y here if you have HIMAX touch panel.

	  If unsure, say N.

	  To compile this dirver as a module, choose M here: the
	  module will be called.

source "drivers/input/touchscreen/mediatek/hxchipset/Kconfig"

config TOUCHSCREEN_MTK_FOCALTECH_HD
	bool "Focaltech Touchscreen"
	depends on I2C
	help
	  Say Y here if you have Focaltech touch panel.
	  If unsure, say N.

source "drivers/input/touchscreen/mediatek/ft8006s_spi/Kconfig"
source "drivers/input/touchscreen/mediatek/nt36xxx_spi/Kconfig"
source "drivers/input/touchscreen/mediatek/chipone/Kconfig"

config TOUCHSCREEN_COMMON
	bool "touchscreen for xiaomi C3L project"
	depends on SPI
	default n
	help
		Say Y here if you have a Xiaomi C3L touchscreen and want to enable support for the built-in touchscreen.

endif
```

## drivers/input/touchscreen/mediatek/nt36xxx_spi/Kconfig
```kconfig
#
# Novatek NT36xxx touchscreen driver configuration
#
config TOUCHSCREEN_NT36XXX_HOSTDL_SPI
	bool "Novatek NT36xxx host download SPI driver"
	depends on SPI
	default n
	help
	  Say Y here if you have a Novatek NT36xxx no flash touchscreen connected
	  to your system by SPI bus.
	  
	  If unsure, say N.

config TOUCHSCREEN_NT36XXX_FW_UPDATE
	bool "Novatek NT36xxx Firmware update SPI driver"
	depends on SPI
	default y
	help
	  Say Y here if you want to use NT36xxx firmware download driver.

config TOUCHSCREEN_NT36XXX_HOSTDL_SPI_C3X
	bool "Novatek NT36xxx host download SPI driver"
	depends on SPI
	default n
	help
	  Say Y here if you have a Novatek NT36xxx no flash touchscreen connected
	  to your system by SPI bus.

	  If unsure, say N.
```

## drivers/misc/mediatek/debug_latch/Kconfig
```kconfig
menuconfig MTK_DEBUG_LATCH
	bool "MediaTek Debug Latch Configuration"
	default n
	help
	  Select to enable MediaTek Debug Latch configuration.
	  Includes LASTPC and LASTBUS module for latching the
	  system status. Also, PLAT_SRAM_FLAG provides APIs to
	  access debugging flags.

if  MTK_DEBUG_LATCH

config MTK_PLAT_SRAM_FLAG
	bool "MediaTek PLATFORM SRAM FLAG"
	default n
	help
	  PLAT_SRAM_FLAG provides APIs to access debugging flags.
	  Which are kept after exception occurs, and we can dump
	  these flags as hints or inputs to post-processing scripts
	  for further analyze.
endif
```

## drivers/misc/mediatek/sched/Kconfig
```kconfig
menu "MTK userspace global cpuset"
config MTK_USER_SPACE_GLOBAL_CPUSET
	bool "Enable user space global cpuset"
	depends on CPUSETS
	default n
	help
	  Interface for set user space global cpuset.
	  It can set user space global cpuset to child
	  group and once unsets, the child cpuset will
	  restore by cpus.

endmenu

menu "MTK load balance and schedule enhancement"

config MTK_IDLE_BALANCE_ENHANCEMENT
	bool "mtk load balance enhancement"
	depends on SMP && CGROUP_SCHEDTUNE
	default n
	help
	  Mediatek aggressive idle balance, include
	  1. aggressive idle balance for runnable tasks with idle prefer attributes
	  2. aggressive idle balance for runnable and running tasks with min_cap(dynamic floor)
	  3. migrate runnable task directly and use stop machine to migrate running task

config MTK_SCHED_TRACE
	bool "mtk scheduling trace, output mtk schedule trace into FTRACE"
	default n
	help
	  MTK scheduling trace, output schedule trace into FTRACE
	  the ftrace api for scheduling is mt_sched_printf and
	  used for scheduling module to output info to ftrace
	  Say Y to enable mtk scheduling trace
endmenu

menu "MTK Heterogenous MultiProcessor Scheduler"

config SCHED_HMP
	bool "Heterogenous multiprocessor scheduling"
	default n
	depends on SCHED_MC && FAIR_GROUP_SCHED && !SCHED_AUTOGROUP
	help
	  Scheduler optimizations for heterogeneous platforms.
	  Attempts to introspectively select task affinity to optimize power
	  and performance. Basic support for multiple (>2) cpu types is in place,
	  but it has only been tested with two types of cpus.
	  There is currently no support for migration of task groups, hence
	  !SCHED_AUTOGROUP.

config SCHED_HMP_PRIO_FILTER
	bool "(EXPERIMENTAL) Filter HMP migrations by task priority"
	default y
	depends on SCHED_HMP
	help
	  Enables task priority based HMP migration filter. Any task with
	  a NICE value above the threshold will always be on low-power cpus
	  with less compute capacity.
	  If unsure say N here.

config SCHED_HMP_PRIO_FILTER_VAL
	int "NICE priority threshold"
	default 5
	depends on SCHED_HMP_PRIO_FILTER

config HMP_FREQUENCY_INVARIANT_SCALE
	bool "(EXPERIMENTAL) Frequency-Invariant Tracked Load for HMP"
	depends on !ARCH_SCALE_INVARIANT_CPU_CAPACITY
	help
	  Scales the current load contribution in line with the frequency
	  of the CPU that the task was executed on.
	  In this version, we use a simple linear scale derived from the
	  maximum frequency reported by CPUFreq.
	  Restricting tracked load to be scaled by the CPU's frequency
	  represents the consumption of possible compute capacity
	  (rather than consumption of actual instantaneous capacity as
	  normal) and allows the HMP migration's simple threshold
	  migration strategy to interact more predictably with CPUFreq's
	  asynchronous compute capacity changes.

config SCHED_HMP_PLUS
	bool "(EXPERIMENTAL) Corepilot enhancement"
	depends on SCHED_HMP
	default y
	help
	  Corepilot hmp enhancement.
	  1. Do hmp_idle_pull at idle_balance
	  2. At global balance, consider the tasks in rq, move heaviest/lightest
	  of first 5 tasks in rq.
	  3. Enhance down migration rule: Do not migrate task when big core
	  is idle

config MTK_SCHED_BOOST
	bool "mtk scheduling boost enhancement"
	depends on SCHED_HMP && CPUSETS && MTK_USER_SPACE_GLOBAL_CPUSET
	default n
	help
	   Sched Boost type:
	   0:  cancel sched boost
	   1:  prefer boost  ALL tasks to big cores
	   2:  foreground task move to big cores

config MTK_RT_ENHANCEMENT
	bool "mt RT scheduling enhancement for big.LITTLE"
	depends on SCHED_HMP && MTK_SCHED_BOOST
	default y

endmenu

menu "MTK runqueue statistic calculation"
config MTK_SCHED_RQAVG_KS
	bool "Enable runqueue statistic calculation used in kernel space operation"
	depends on SMP
	help
	  MTK ruqueue statistic kernel space CPUfreq governors, e.g., hotplug
	  TLP estimation,
	  heavy task detection and
	  per CPU load for kernel space CPUfreq governors

config MTK_SCHED_RQAVG_US
	bool "Enable runqueue staticsic calculation used in user space operation"
	depends on SMP && HIGH_RES_TIMERS
	help
	  MTK runqueue staticsic calculation
	  used in user space operation.
	  TLP estimation for user space
	  CPUfreq governors.

config MTK_SCHED_CPULOAD
	bool "Enable timing-base CPU loading tracking in scheduler"
	depends on MTK_SCHED_RQAVG_US
	help
	  Support timing-base CPU loading tracking
	  in scheduler tick.
	  Which helps load tracking in time-base view
	  and more quick response in loading change.

config MTK_SCHED_SYSHINT
	bool "Enable asynchronus hint for external modules to get loading change in time"
	help
	  Support asynchronus hint for external modules
	  to get loading change notification from scheduler
	  in time that helps resource control
	  in low latency.

endmenu
```

## kuroneko/Kconfig
```kconfig
comment "Kuroneko Kernel Configuration"

config KURONEKO
	bool "Enable Kuroneko features"
	default y
	help
	  Enable Kuroneko additional features 

	  If you are building Kuroneko release build
	  then say Y, else say N. If unsure say N.

choice
  prompt "Kuroneko release type"
  depends on KURONEKO
  
  config KURONEKO_STABLE
  	bool "Kuroneko Stable release"
  	help
  	  Build Kuroneko Stable release
  
  	  If you are building a Kuroneko release
  	  then say Y (recommended), else say N. If unsure say N.
  
  config KURONEKO_BALANCE
  	bool "Kuroneko Balance release"
  	help
  	  Build Kuroneko Balance release
  
  	  If you are building a Kuroneko release and want it to be balanced
  	  then say Y (recommended), else say N. If unsure say N.
  	  
  config KURONEKO_POWERSAVE
  	bool "Kuroneko Powersave release"
  	help
  	  Build Kuroneko Powersave release
  
  	  If you are building a Kuroneko release and want it to be powersave
  	  then say Y (recommended), else say N. If unsure say N.
  	  
  config KURONEKO_GAMING
  	bool "Kuroneko Gaming release"
  	help
  	  Build Kuroneko Gaming release
  
  	  If you are building a Kuroneko release and want it to be for gaming
  	  then say Y (recommended), else say N. If unsure say N.
  
  config KURONEKO_EXTREME
  	bool "Kuroneko Extreme release"
  	help
  	  Build Kuroneko Extreme release
  
  	  If you are building a Kuroneko release and want it to be extreme
  	  then say Y, else say N. If unsure say N.
endchoice
```

## sound/soc/mediatek/Kconfig
```kconfig
config MTK_SND_SOC_CODEC
	string "String for Mediatek audio codec"
	help
	  Specify Mediatek audio codec.
	  It depend on the string to choose the audio codec.
	  Say "mt6351" if you have mt6351 audio codec.
	  Say "mt6337" if you have mt6337 audio codec.
	  Say "mt6355" if you have mt6355 audio codec.
	  
config SND_SOC_MTK_BTCVSD
	bool "MTK BT CVSD ALSA ARICHITECTURE"
	default n
	help
	  If you say Y, enable SND_SOC_MTK_BTCVSD.
	  This is for software BTCVSD. This enable
	  the function for transferring/receiving
	  BT encoded data to/from BT firmware.

config MTK_SND_SOC_NEW_ARCH
	bool "Support new audio architecture"
	select REGMAP_MMIO
	help
	  If you say Y, enable MTK_SND_SOC_NEW_ARCH.
	  Only enable this when you use refactored audio driver architecture.
	  If new chip after mt6757, we will enable this config.
	  Audio driver refactor to common folder and platform folder.
```
